/******************************************************************************
* ASAP2 file: ApplBTA_LDM.a2l
* Code generation for model "ApplBTA_LDM".
* Model version : 1.22
* Simulink Coder version : 9.0 (R2018b) 24-May-2018
* C source code generated on : Mon Feb 6 09:53:17 2023
* Target selection: ert.tlc
* Embedded hardware selection: Intel->x86-64 (Windows64)
* Code generation objectives: Unspecified
* Validation result: Not run
* (add additional file header information here)
******************************************************************************/ ASAP2_VERSION 1 31
/* Version 1.31 */
/begin PROJECT ProjectName "Project Comment Goes Here"
/begin HEADER "Header Comments go here" /end HEADER
/begin MODULE ModuleName "Module Comment Goes Here"
/begin MOD_PAR "MOD PAR Comment Goes Here" /end MOD_PAR
/begin MOD_COMMON "Mod Common Comment Here" BYTE_ORDER MSB_LAST /end MOD_COMMON
/begin RECORD_LAYOUT Scalar_BOOLEAN FNC_VALUES 1 UBYTE COLUMN_DIR DIRECT /end RECORD_LAYOUT
/begin RECORD_LAYOUT Scalar_UBYTE FNC_VALUES 1 UBYTE COLUMN_DIR DIRECT /end RECORD_LAYOUT
/begin RECORD_LAYOUT Scalar_BYTE FNC_VALUES 1 SBYTE COLUMN_DIR DIRECT /end RECORD_LAYOUT
/begin RECORD_LAYOUT Scalar_UWORD FNC_VALUES 1 UWORD COLUMN_DIR DIRECT /end RECORD_LAYOUT
/begin RECORD_LAYOUT Scalar_SWORD FNC_VALUES 1 SWORD COLUMN_DIR DIRECT /end RECORD_LAYOUT
/begin RECORD_LAYOUT Scalar_ULONG FNC_VALUES 1 ULONG COLUMN_DIR DIRECT /end RECORD_LAYOUT
/begin RECORD_LAYOUT Scalar_LONG FNC_VALUES 1 SLONG COLUMN_DIR DIRECT /end RECORD_LAYOUT
/begin RECORD_LAYOUT Scalar_FLOAT32_IEEE FNC_VALUES 1 FLOAT32_IEEE COLUMN_DIR DIRECT /end RECORD_LAYOUT
/begin RECORD_LAYOUT Scalar_FLOAT64_IEEE FNC_VALUES 1 FLOAT64_IEEE COLUMN_DIR DIRECT /end RECORD_LAYOUT
/begin RECORD_LAYOUT Lookup1D_BOOLEAN FNC_VALUES 1 UBYTE COLUMN_DIR DIRECT /end RECORD_LAYOUT
/begin RECORD_LAYOUT Lookup1D_X_BOOLEAN AXIS_PTS_X 1 UBYTE INDEX_INCR DIRECT /end RECORD_LAYOUT
/begin RECORD_LAYOUT Lookup1D_BYTE FNC_VALUES 1 SBYTE COLUMN_DIR DIRECT /end RECORD_LAYOUT
/begin RECORD_LAYOUT Lookup1D_X_BYTE AXIS_PTS_X 1 SBYTE INDEX_INCR DIRECT /end RECORD_LAYOUT
/begin RECORD_LAYOUT Lookup1D_UBYTE FNC_VALUES 1 UBYTE COLUMN_DIR DIRECT /end RECORD_LAYOUT
/begin RECORD_LAYOUT Lookup1D_X_UBYTE AXIS_PTS_X 1 UBYTE INDEX_INCR DIRECT /end RECORD_LAYOUT
/begin RECORD_LAYOUT Lookup1D_UWORD FNC_VALUES 1 UWORD COLUMN_DIR DIRECT /end RECORD_LAYOUT
/begin RECORD_LAYOUT Lookup1D_X_UWORD AXIS_PTS_X 1 UWORD INDEX_INCR DIRECT /end RECORD_LAYOUT
/begin RECORD_LAYOUT Lookup1D_WORD FNC_VALUES 1 SWORD COLUMN_DIR DIRECT /end RECORD_LAYOUT
/begin RECORD_LAYOUT Lookup1D_X_WORD AXIS_PTS_X 1 SWORD INDEX_INCR DIRECT /end RECORD_LAYOUT
/begin RECORD_LAYOUT Lookup1D_ULONG FNC_VALUES 1 ULONG COLUMN_DIR DIRECT /end RECORD_LAYOUT
/begin RECORD_LAYOUT Lookup1D_X_ULONG AXIS_PTS_X 1 ULONG INDEX_INCR DIRECT /end RECORD_LAYOUT
/begin RECORD_LAYOUT Lookup1D_SLONG FNC_VALUES 1 SLONG COLUMN_DIR DIRECT /end RECORD_LAYOUT
/begin RECORD_LAYOUT Lookup1D_X_LONG AXIS_PTS_X 1 SLONG INDEX_INCR DIRECT /end RECORD_LAYOUT
/begin RECORD_LAYOUT Lookup1D_FLOAT32_IEEE FNC_VALUES 1 FLOAT32_IEEE COLUMN_DIR DIRECT /end RECORD_LAYOUT
/begin RECORD_LAYOUT Lookup1D_X_FLOAT32_IEEE AXIS_PTS_X 1 FLOAT32_IEEE INDEX_INCR DIRECT /end RECORD_LAYOUT
/begin RECORD_LAYOUT Lookup1D_FLOAT64_IEEE FNC_VALUES 1 FLOAT64_IEEE COLUMN_DIR DIRECT /end RECORD_LAYOUT
/begin RECORD_LAYOUT Lookup1D_X_FLOAT64_IEEE AXIS_PTS_X 1 FLOAT64_IEEE INDEX_INCR DIRECT /end RECORD_LAYOUT
/begin RECORD_LAYOUT Lookup2D_BOOLEAN FNC_VALUES 1 UBYTE COLUMN_DIR DIRECT /end RECORD_LAYOUT
/begin RECORD_LAYOUT Lookup2D_X_BOOLEAN AXIS_PTS_X 1 UBYTE INDEX_INCR DIRECT /end RECORD_LAYOUT
/begin RECORD_LAYOUT Lookup2D_UBYTE FNC_VALUES 1 UBYTE COLUMN_DIR DIRECT /end RECORD_LAYOUT
/begin RECORD_LAYOUT Lookup2D_X_UBYTE AXIS_PTS_X 1 UBYTE INDEX_INCR DIRECT /end RECORD_LAYOUT
/begin RECORD_LAYOUT Lookup2D_BYTE FNC_VALUES 1 SBYTE COLUMN_DIR DIRECT /end RECORD_LAYOUT
/begin RECORD_LAYOUT Lookup2D_X_BYTE AXIS_PTS_X 1 SBYTE INDEX_INCR DIRECT /end RECORD_LAYOUT
/begin RECORD_LAYOUT Lookup2D_UWORD FNC_VALUES 1 UWORD COLUMN_DIR DIRECT /end RECORD_LAYOUT
/begin RECORD_LAYOUT Lookup2D_X_UWORD AXIS_PTS_X 1 UWORD INDEX_INCR DIRECT /end RECORD_LAYOUT
/begin RECORD_LAYOUT Lookup2D_WORD FNC_VALUES 1 SWORD COLUMN_DIR DIRECT /end RECORD_LAYOUT
/begin RECORD_LAYOUT Lookup2D_X_WORD AXIS_PTS_X 1 SWORD INDEX_INCR DIRECT /end RECORD_LAYOUT
/begin RECORD_LAYOUT Lookup2D_ULONG FNC_VALUES 1 ULONG COLUMN_DIR DIRECT /end RECORD_LAYOUT
/begin RECORD_LAYOUT Lookup2D_X_ULONG AXIS_PTS_X 1 ULONG INDEX_INCR DIRECT /end RECORD_LAYOUT
/begin RECORD_LAYOUT Lookup2D_LONG FNC_VALUES 1 SLONG COLUMN_DIR DIRECT /end RECORD_LAYOUT
/begin RECORD_LAYOUT Lookup2D_X_LONG AXIS_PTS_X 1 SLONG INDEX_INCR DIRECT /end RECORD_LAYOUT
/begin RECORD_LAYOUT Lookup2D_FLOAT32_IEEE FNC_VALUES 1 FLOAT32_IEEE COLUMN_DIR DIRECT /end RECORD_LAYOUT
/begin RECORD_LAYOUT Lookup2D_X_FLOAT32_IEEE AXIS_PTS_X 1 FLOAT32_IEEE INDEX_INCR DIRECT /end RECORD_LAYOUT
/begin RECORD_LAYOUT Lookup2D_FLOAT64_IEEE FNC_VALUES 1 FLOAT64_IEEE COLUMN_DIR DIRECT /end RECORD_LAYOUT
/begin RECORD_LAYOUT Lookup2D_X_FLOAT64_IEEE AXIS_PTS_X 1 FLOAT64_IEEE INDEX_INCR DIRECT /end RECORD_LAYOUT
/begin CHARACTERISTIC K10_LDM_torqOLCtrlerTableY "Output breakpoints of table for open loop controller (from decel request to brake torq)" /* Characteristic Type */ CURVE 0x0000 /* @ECU_Address@K10_LDM_torqOLCtrlerTableY@ */ Lookup1D_FLOAT32_IEEE /* Maxdiff */ 0 ApplBTA_LDM_CM_single -3.4E+38 3.4E+38
 /begin AXIS_DESCR /* Description of X-Axis Points */ /* Axis Type */ COM_AXIS /* Reference to Input */ V_LDM_aCtrlerSetpoint_f32 ApplBTA_LDM_CM_single /* Number of Axis Pts */ 10 -3.4E+38 3.4E+38 AXIS_PTS_REF K10_LDM_aOLCtrlerTableX /end AXIS_DESCR
/end CHARACTERISTIC
/begin AXIS_PTS K10_LDM_aOLCtrlerTableX "Input breakpoints of table for open loop controller (from decel request to brake torq)" 0x0000 /* @ECU_Address@K10_LDM_aOLCtrlerTableX@ */ /* Input Quantity */ V_LDM_aCtrlerSetpoint_f32 Lookup1D_X_FLOAT32_IEEE 0 ApplBTA_LDM_CM_single /* Number of Axis Pts */ 10 -3.4E+38 3.4E+38 /end AXIS_PTS
/begin CHARACTERISTIC K_LDM_coDecelCtrlCl2OlLim "" VALUE 0x0000 /* @ECU_Address@K_LDM_coDecelCtrlCl2OlLim@ */ Scalar_FLOAT32_IEEE 0 ApplBTA_LDM_CM_single_km_hr -3.4E+38 3.4E+38 /end CHARACTERISTIC
/begin CHARACTERISTIC K_LDM_coDecelCtrlHigh2LowLim "" VALUE 0x0000 /* @ECU_Address@K_LDM_coDecelCtrlHigh2LowLim@ */ Scalar_FLOAT32_IEEE 0 ApplBTA_LDM_CM_single_km_hr -3.4E+38 3.4E+38 /end CHARACTERISTIC
/begin CHARACTERISTIC K_LDM_coDecelCtrlLow2HighLim "" VALUE 0x0000 /* @ECU_Address@K_LDM_coDecelCtrlLow2HighLim@ */ Scalar_FLOAT32_IEEE 0 ApplBTA_LDM_CM_single_km_hr -3.4E+38 3.4E+38 /end CHARACTERISTIC
/begin CHARACTERISTIC K_LDM_coDecelCtrlOl2ClLim "" VALUE 0x0000 /* @ECU_Address@K_LDM_coDecelCtrlOl2ClLim@ */ Scalar_FLOAT32_IEEE 0 ApplBTA_LDM_CM_single_km_hr -3.4E+38 3.4E+38 /end CHARACTERISTIC
/begin CHARACTERISTIC K_LDM_coDecelParalCtrlCST_I "" VALUE 0x0000 /* @ECU_Address@K_LDM_coDecelParalCtrlCST_I@ */ Scalar_FLOAT32_IEEE 0 ApplBTA_LDM_CM_single -3.4E+38 3.4E+38 /end CHARACTERISTIC
/begin CHARACTERISTIC K_LDM_coDecelParalCtrlCST_P "" VALUE 0x0000 /* @ECU_Address@K_LDM_coDecelParalCtrlCST_P@ */ Scalar_FLOAT32_IEEE 0 ApplBTA_LDM_CM_single -3.4E+38 3.4E+38 /end CHARACTERISTIC
/begin CHARACTERISTIC K_LDM_coDecelParalCtrlEbrSB_I "" VALUE 0x0000 /* @ECU_Address@K_LDM_coDecelParalCtrlEbrSB_I@ */ Scalar_FLOAT32_IEEE 0 ApplBTA_LDM_CM_single -3.4E+38 3.4E+38 /end CHARACTERISTIC
/begin CHARACTERISTIC K_LDM_coDecelParalCtrlEbrSB_P "" VALUE 0x0000 /* @ECU_Address@K_LDM_coDecelParalCtrlEbrSB_P@ */ Scalar_FLOAT32_IEEE 0 ApplBTA_LDM_CM_single -3.4E+38 3.4E+38 /end CHARACTERISTIC
/begin CHARACTERISTIC K_LDM_coDecelParalCtrlHighSpd_I "" VALUE 0x0000 /* @ECU_Address@K_LDM_coDecelParalCtrlHighSpd_I@ */ Scalar_FLOAT32_IEEE 0 ApplBTA_LDM_CM_single -3.4E+38 3.4E+38 /end CHARACTERISTIC
/begin CHARACTERISTIC K_LDM_coDecelParalCtrlHighSpd_P "" VALUE 0x0000 /* @ECU_Address@K_LDM_coDecelParalCtrlHighSpd_P@ */ Scalar_FLOAT32_IEEE 0 ApplBTA_LDM_CM_single -3.4E+38 3.4E+38 /end CHARACTERISTIC
/begin CHARACTERISTIC K_LDM_coDecelParalCtrlLowSpd_I "" VALUE 0x0000 /* @ECU_Address@K_LDM_coDecelParalCtrlLowSpd_I@ */ Scalar_FLOAT32_IEEE 0 ApplBTA_LDM_CM_single -3.4E+38 3.4E+38 /end CHARACTERISTIC
/begin CHARACTERISTIC K_LDM_coDecelParalCtrlLowSpd_P "" VALUE 0x0000 /* @ECU_Address@K_LDM_coDecelParalCtrlLowSpd_P@ */ Scalar_FLOAT32_IEEE 0 ApplBTA_LDM_CM_single -3.4E+38 3.4E+38 /end CHARACTERISTIC
/begin CHARACTERISTIC K_LDM_torqDecelClsCtrlerLowLim "" VALUE 0x0000 /* @ECU_Address@K_LDM_torqDecelClsCtrlerLowLim@ */ Scalar_FLOAT32_IEEE 0 ApplBTA_LDM_CM_single_N_m -3.4E+38 3.4E+38 /end CHARACTERISTIC
/begin CHARACTERISTIC K_LDM_torqDecelClsCtrlerUpLim "" VALUE 0x0000 /* @ECU_Address@K_LDM_torqDecelClsCtrlerUpLim@ */ Scalar_FLOAT32_IEEE 0 ApplBTA_LDM_CM_single_N_m -3.4E+38 3.4E+38 /end CHARACTERISTIC
/begin CHARACTERISTIC K_LDM_torqDecelCtrlerLowLim "" VALUE 0x0000 /* @ECU_Address@K_LDM_torqDecelCtrlerLowLim@ */ Scalar_FLOAT32_IEEE 0 ApplBTA_LDM_CM_single_N_m -3.4E+38 3.4E+38 /end CHARACTERISTIC
/begin CHARACTERISTIC K_LDM_torqDecelCtrlerUpLim "" VALUE 0x0000 /* @ECU_Address@K_LDM_torqDecelCtrlerUpLim@ */ Scalar_FLOAT32_IEEE 0 ApplBTA_LDM_CM_single_N_m -3.4E+38 3.4E+38 /end CHARACTERISTIC
/begin CHARACTERISTIC K_LDM_torqOLCtrlerLowLim "" VALUE 0x0000 /* @ECU_Address@K_LDM_torqOLCtrlerLowLim@ */ Scalar_FLOAT32_IEEE 0 ApplBTA_LDM_CM_single_N_m -3.4E+38 3.4E+38 /end CHARACTERISTIC
/begin CHARACTERISTIC K_LDM_torqOLCtrlerUpLim "" VALUE 0x0000 /* @ECU_Address@K_LDM_torqOLCtrlerUpLim@ */ Scalar_FLOAT32_IEEE 0 ApplBTA_LDM_CM_single_N_m -3.4E+38 3.4E+38 /end CHARACTERISTIC
/begin CHARACTERISTIC K_LDM_blClsLoopCtrlEnable_bl "" VALUE 0x0000 /* @ECU_Address@K_LDM_blClsLoopCtrlEnable_bl@ */ Scalar_BOOLEAN 0 ApplBTA_LDM_CM_boolean 0 1 /end CHARACTERISTIC
/begin MEASUREMENT V_LDM_torqDecelCtrlerOut_f32 "" FLOAT32_IEEE ApplBTA_LDM_CM_single_N_m 0 0 -3.4E+38 3.4E+38 ECU_ADDRESS 0x0000 /* @ECU_Address@V_LDM_torqDecelCtrlerOut_f32@ */ /end MEASUREMENT
/begin MEASUREMENT V_LDM_aCtrlErr_f32 "Feedback error of Decel Controller." FLOAT32_IEEE ApplBTA_LDM_CM_single 0 0 -3.4E+38 3.4E+38 ECU_ADDRESS 0x0000 /* @ECU_Address@V_LDM_aCtrlErr_f32@ */ /end MEASUREMENT
/begin MEASUREMENT V_LDM_coCtrlerPCoeff_f32 "current P coefficience of Decel PID controller" FLOAT32_IEEE ApplBTA_LDM_CM_single 0 0 -3.4E+38 3.4E+38 ECU_ADDRESS 0x0000 /* @ECU_Address@V_LDM_coCtrlerPCoeff_f32@ */ /end MEASUREMENT
/begin MEASUREMENT V_LDM_coCtrlerICoeff_f32 "" FLOAT32_IEEE ApplBTA_LDM_CM_single 0 0 -3.4E+38 3.4E+38 ECU_ADDRESS 0x0000 /* @ECU_Address@V_LDM_coCtrlerICoeff_f32@ */ /end MEASUREMENT
/begin MEASUREMENT V_LDM_aCtrlerSetpoint_f32 "" FLOAT32_IEEE ApplBTA_LDM_CM_single 0 0 -3.4E+38 3.4E+38 ECU_ADDRESS 0x0000 /* @ECU_Address@V_LDM_aCtrlerSetpoint_f32@ */ /end MEASUREMENT
/begin MEASUREMENT V_LDM_vldDecelCtrlerOutVD_bl "" SLONG ApplBTA_LDM_CM_LDM_VLD_EN_T 0 0 0 1 ECU_ADDRESS 0x0000 /* @ECU_Address@V_LDM_vldDecelCtrlerOutVD_bl@ */ /end MEASUREMENT
/begin MEASUREMENT V_LDM_stBrkSrcMode_en "" SLONG ApplBTA_LDM_CM_LDM_BRK_SRC_MODE_EN_T 0 0 0 2 ECU_ADDRESS 0x0000 /* @ECU_Address@V_LDM_stBrkSrcMode_en@ */ /end MEASUREMENT
/begin MEASUREMENT V_LDM_stCtrlMode_en "" SLONG ApplBTA_LDM_CM_LDMCtrlMode_en_t 0 0 0 2 ECU_ADDRESS 0x0000 /* @ECU_Address@V_LDM_stCtrlMode_en@ */ /end MEASUREMENT
/begin MEASUREMENT V_LDM_stBrkArbMode_en "" SLONG ApplBTA_LDM_CM_LDMBrkArbMode_en_t 0 0 0 11 ECU_ADDRESS 0x0000 /* @ECU_Address@V_LDM_stBrkArbMode_en@ */ /end MEASUREMENT
/begin COMPU_METHOD ApplBTA_LDM_CM_single "Q = V" RAT_FUNC "%8.6" "" COEFFS 0 1 0 0 0 1 /end COMPU_METHOD
/begin COMPU_METHOD ApplBTA_LDM_CM_single_km_hr "Q = V" RAT_FUNC "%8.6" "km/hr" COEFFS 0 1 0 0 0 1 /end COMPU_METHOD
/begin COMPU_METHOD ApplBTA_LDM_CM_single_N_m "Q = V" RAT_FUNC "%8.6" "N*m" COEFFS 0 1 0 0 0 1 /end COMPU_METHOD
/begin COMPU_METHOD ApplBTA_LDM_CM_boolean "Q = V" RAT_FUNC "%1.0" "" COEFFS 0 1 0 0 0 1 /end COMPU_METHOD
/begin COMPU_METHOD ApplBTA_LDM_CM_LDM_VLD_EN_T "Enumerated data type: LDM_VLD_EN_T" TAB_VERB "%0.6" "" COMPU_TAB_REF VTAB_FOR_ApplBTA_LDM_CM_LDM_VLD_EN_T /end COMPU_METHOD
/begin COMPU_VTAB VTAB_FOR_ApplBTA_LDM_CM_LDM_VLD_EN_T "Enumerated data type: LDM_VLD_EN_T" TAB_VERB 2 0 "VALID" 1 "INVALID" /end COMPU_VTAB
/begin COMPU_METHOD ApplBTA_LDM_CM_LDM_BRK_SRC_MODE_EN_T "Enumerated data type: LDM_BRK_SRC_MODE_EN_T" TAB_VERB "%0.6" "" COMPU_TAB_REF VTAB_FOR_ApplBTA_LDM_CM_LDM_BRK_SRC_MODE_EN_T /end COMPU_METHOD
/begin COMPU_VTAB VTAB_FOR_ApplBTA_LDM_CM_LDM_BRK_SRC_MODE_EN_T "Enumerated data type: LDM_BRK_SRC_MODE_EN_T" TAB_VERB 3 0 "BTA_EXTERNAL_BRAKE" 1 "BTA_PEDAL_APPLIED" 2 "BTA_PEDAL_BRAKE_NONE" /end COMPU_VTAB
/begin COMPU_METHOD ApplBTA_LDM_CM_LDMCtrlMode_en_t "Enumerated data type: LDMCtrlMode_en_t" TAB_VERB "%0.6" "" COMPU_TAB_REF VTAB_FOR_ApplBTA_LDM_CM_LDMCtrlMode_en_t /end COMPU_METHOD
/begin COMPU_VTAB VTAB_FOR_ApplBTA_LDM_CM_LDMCtrlMode_en_t "Enumerated data type: LDMCtrlMode_en_t" TAB_VERB 3 0 "DecelCtrl" 1 "OLCtrl" 2 "SpeedCtrl" /end COMPU_VTAB
/begin COMPU_METHOD ApplBTA_LDM_CM_LDMBrkArbMode_en_t "Enumerated data type: LDMBrkArbMode_en_t" TAB_VERB "%0.6" "" COMPU_TAB_REF VTAB_FOR_ApplBTA_LDM_CM_LDMBrkArbMode_en_t /end COMPU_METHOD
/begin COMPU_VTAB VTAB_FOR_ApplBTA_LDM_CM_LDMBrkArbMode_en_t "Enumerated data type: LDMBrkArbMode_en_t" TAB_VERB 12 0 "Standby" 1 "EBR_Standby" 2 "EBR_NormCtrl" 3 "EBR_SelfBrake" 4 "EBR_HldPres" 5 "EBR_Error" 6 "DBR_Init" 7 "DBR_NormCtrl" 8 "DBR_EmergCtrl" 9 "DBR_CST" 10 "DBR_HldPres" 11 "DBR_Error" /end COMPU_VTAB
/begin GROUP ApplBTA_LDM "ApplBTA_LDM" /* Root */ ROOT /begin SUB_GROUP Root_Parallel_Hybird_Controller /end SUB_GROUP /end GROUP
/begin GROUP Root_Parallel_Hybird_Controller "ApplBTA_LDM/Parallel-Hybird Controller" /begin SUB_GROUP S1_Decel_open_loop_controler /end SUB_GROUP
 /begin REF_CHARACTERISTIC K_LDM_blClsLoopCtrlEnable_bl K_LDM_coDecelCtrlCl2OlLim K_LDM_coDecelCtrlHigh2LowLim K_LDM_coDecelCtrlLow2HighLim K_LDM_coDecelCtrlOl2ClLim K_LDM_coDecelParalCtrlCST_I K_LDM_coDecelParalCtrlCST_P K_LDM_coDecelParalCtrlEbrSB_I K_LDM_coDecelParalCtrlEbrSB_P K_LDM_coDecelParalCtrlHighSpd_I K_LDM_coDecelParalCtrlHighSpd_P K_LDM_coDecelParalCtrlLowSpd_I K_LDM_coDecelParalCtrlLowSpd_P K_LDM_torqDecelClsCtrlerLowLim K_LDM_torqDecelClsCtrlerUpLim K_LDM_torqDecelCtrlerLowLim K_LDM_torqDecelCtrlerUpLim K_LDM_torqOLCtrlerLowLim K_LDM_torqOLCtrlerUpLim /end REF_CHARACTERISTIC
 /begin REF_MEASUREMENT V_LDM_aCtrlErr_f32 V_LDM_aCtrlerSetpoint_f32 V_LDM_coCtrlerICoeff_f32 V_LDM_coCtrlerPCoeff_f32 V_LDM_stBrkArbMode_en V_LDM_stBrkSrcMode_en V_LDM_stCtrlMode_en V_LDM_torqDecelCtrlerOut_f32 V_LDM_vldDecelCtrlerOutVD_bl /end REF_MEASUREMENT
/end GROUP
/begin GROUP S1_Decel_open_loop_controler "ApplBTA_LDM/Parallel-Hybird Controller/Decel open-loop controler" /begin REF_CHARACTERISTIC K10_LDM_torqOLCtrlerTableY /end REF_CHARACTERISTIC /end GROUP
/end MODULE
/end PROJECT
/* (add any file trailer comments here) */
/* EOF ApplBTA_LDM.a2l */
